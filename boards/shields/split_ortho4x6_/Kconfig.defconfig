## boards/shields/split_ortho4x6_/Kconfig.defconfig
```kconfig
if SHIELD_SPLIT_ORTHO4X6__RIGHT

config ZMK_KEYBOARD_NAME
    default "split_ortho4x6_"

endif

if SHIELD_SPLIT_ORTHO4X6__LEFT || SHIELD_SPLIT_ORTHO4X6__RIGHT

config ZMK_SPLIT
    default y

endif
```

## boards/shields/split_ortho4x6_/Kconfig.shield
```kconfig
config SHIELD_SPLIT_ORTHO4X6__LEFT
    def_bool $(shields_list_contains,split_ortho4x6__left)
config SHIELD_SPLIT_ORTHO4X6__RIGHT
    def_bool $(shields_list_contains,split_ortho4x6__right)
```
